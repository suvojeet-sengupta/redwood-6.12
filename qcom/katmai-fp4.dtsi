// SPDX-License-Identifier: BSD-3-Clause
/*
 * Copyright (c) Qualcomm Technologies, Inc. and/or its subsidiaries.
 */

#include "yupik-iot.dtsi"

/ {
	model = "Qualcomm Technologies, Inc. KATMAI-FP4 SoC";
	compatible = "qcom,yupik-iot";
	qcom,msm-id = <576 0x10000>;
	qcom,softsku-id = <4>;
};
