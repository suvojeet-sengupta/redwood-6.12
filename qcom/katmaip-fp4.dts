// SPDX-License-Identifier: BSD-3-Clause
/*
 * Copyright (c) Qualcomm Technologies, Inc. and/or its subsidiaries.
 */

/dts-v1/;

#include "katmaip-fp4.dtsi"

/ {
	model = "Qualcomm Technologies, Inc. KATMAIP FP4 SoC";
	compatible = "qcom,yupikp-iot";
	qcom,board-id = <0 0>;
};
