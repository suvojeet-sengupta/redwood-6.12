// SPDX-License-Identifier: BSD-3-Clause
/*
 * Bluetooth power for the WCN6750 (modules/btpower), from the 5.4 yupik
 * device tree; 6.12 has no BT node for Yupik. The HCI side is /dev/ttyHS0
 * (qupv3_se7_4uart), which 6.12 already has.
 */

&soc {
	bluetooth: bt_wcn6750 {
		compatible = "qcom,wcn6750-bt";
		pinctrl-names = "default";
		pinctrl-0 = <&bt_en_sleep>;
		qcom,bt-reset-gpio = <&tlmm 85 0>;
		qcom,bt-sw-ctrl-gpio = <&tlmm 86 0>;
		qcom,wl-reset-gpio = <&tlmm 84 0>;

		qcom,bt-vdd-io-supply = <&L19B>;
		qcom,bt-vdd-aon-supply = <&S7B>;
		qcom,bt-vdd-dig-supply = <&S7B>;
		qcom,bt-vdd-rfacmn-supply = <&S7B>;
		qcom,bt-vdd-rfa-0p8-supply = <&S7B>;
		qcom,bt-vdd-rfa1-supply = <&S1B>;
		qcom,bt-vdd-rfa2-supply = <&S8B>;
		qcom,bt-vdd-ipa-2p2-supply = <&S1C>;
		qcom,bt-vdd-asd-supply = <&L11C>;

		qcom,bt-vdd-io-config = <1800000 2000000 0 1>;
		qcom,bt-vdd-aon-config = <824000 1120000 0 1>;
		qcom,bt-vdd-dig-config = <824000 1120000 0 1>;
		qcom,bt-vdd-rfacmn-config = <824000 1120000 0 1>;
		qcom,bt-vdd-rfa-0p8-config = <824000 1120000 0 1>;
		qcom,bt-vdd-rfa1-config = <1872000 2040000 0 1>;
		qcom,bt-vdd-rfa2-config = <1256000 1500000 0 1>;
		qcom,bt-vdd-ipa-2p2-config = <2200000 2210000 0 1>;
		qcom,bt-vdd-asd-config = <2800000 3544000 0 1>;
	};
};
