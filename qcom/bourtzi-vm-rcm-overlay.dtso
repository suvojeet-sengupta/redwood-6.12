// SPDX-License-Identifier: BSD-3-Clause
/*
 * Copyright (c) Qualcomm Technologies, Inc. and/or its subsidiaries.
 */
/dts-v1/;
/plugin/;

#include "bourtzi-vm-avf.dtsi"
#include "bourtzi-vm-rcm-avf.dtsi"

/ {
	model = "Qualcomm Technologies, Inc. Bourtzi SVM RCM";
	compatible = "qcom,bourtzi-rcm", "qcom,rcm", "qcom,bourtzi";
	qcom,board-id = <0x20015 0x0>, <0x40015 0x0>;

	host {
	};
};
